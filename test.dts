/dts-v1/;

/ {
	compatible = "pine64,rockpro64-v2.1";

	chosen {
		fwupd {
			firmware {
				compatible = "fwupd,simple";
				model = "sandbox";
				cur-version = "1.2.3";
				bootloader-version = "2022.01";
				storage = "/tmp/testfw";
				area-start = <0x100000>;
				area-size = <0x100000>;
				skip-offset = <0x8000>;
			};
		};
	};
};
