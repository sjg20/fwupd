/dts-v1/;

/ {
	chosen {
		fwupd {
			firmware {
				compatible = "fwupd,simple";
				cur-version = "1.2.3";
				bootloader-version = "2022.01";
				storage = "mmc1";
				block-start = <0x800>;
				block-count = <0x800>;
			};
		};
	};
};
